## configs/Cubietruck_defconfig
```kconfig
CONFIG_ARM=y
CONFIG_ARCH_SUNXI=y
CONFIG_MACH_SUN7I=y
CONFIG_DRAM_CLK=432
CONFIG_MMC0_CD_PIN="PH1"
CONFIG_USB0_VBUS_PIN="PH17"
CONFIG_USB0_VBUS_DET="PH22"
CONFIG_USB0_ID_DET="PH19"
CONFIG_VIDEO_VGA=y
CONFIG_SATAPWR="PH12"
CONFIG_GMAC_TX_DELAY=1
CONFIG_DEFAULT_DEVICE_TREE="sun7i-a20-cubietruck"
CONFIG_AHCI=y
# CONFIG_SYS_MALLOC_CLEAR_ON_INIT is not set
CONFIG_SPL=y
CONFIG_SPL_I2C_SUPPORT=y
CONFIG_CMD_DFU=y
# CONFIG_CMD_FLASH is not set
# CONFIG_CMD_FPGA is not set
CONFIG_CMD_USB_MASS_STORAGE=y
# CONFIG_SPL_DOS_PARTITION is not set
# CONFIG_SPL_ISO_PARTITION is not set
# CONFIG_SPL_PARTITION_UUIDS is not set
CONFIG_SCSI_AHCI=y
CONFIG_DFU_RAM=y
CONFIG_ETH_DESIGNWARE=y
CONFIG_RGMII=y
CONFIG_SUN7I_GMAC=y
CONFIG_SCSI=y
CONFIG_USB_EHCI_HCD=y
CONFIG_USB_MUSB_GADGET=y
CONFIG_SYS_USB_EVENT_POLL_VIA_INT_QUEUE=y

#
# MMC config changes due to the NAND support added below: 
#
# We need more space for the MMC stored u-Boot with the NAND options
# => we shift ENV_OFFSET by 0x40000 = 256kB
# CONFIG_ENV_OFFSET default 0x88000 if ARCH_SUNXI - as defined in env/Kconfig
CONFIG_ENV_OFFSET=0xC8000

#
# NAND:
#
CONFIG_NAND_SUNXI=y
CONFIG_SPL_NAND_SUPPORT=y
#CONFIG_NAND=y
#CONFIG_MTD=y
#CONFIG_MTDIDS_DEFAULT="nand0=sunxi-nand"
#CONFIG_MTDPARTS_DEFAULT="mtdparts=sunxi-nand:2m(boot0)ro,2m(boot0-rescue)ro,2m(uboot)ro,2m(uboot-rescue)ro,-(rootfs)"
#
# SPL loader NAND offsets:
#
CONFIG_SYS_NAND_U_BOOT_OFFS=0x400000
CONFIG_SYS_NAND_U_BOOT_OFFS_REDUND=0x600000
#
# Cubietruck comes with NAND H27UCG8T2ATR-BC - the following image-builder config works for boot0:
#
#sunxi-nand-image-builder -p 8192 -o 640 -e 0x100000 -b -u 4096 -c 64/1024 $SUNXI_SPL_BIN $SUNXI_NAND_RAW_BOOT0_BIN
#
CONFIG_NAND_SUNXI_SPL_ECC_STRENGTH=64
CONFIG_NAND_SUNXI_SPL_ECC_SIZE=1024
CONFIG_NAND_SUNXI_SPL_USABLE_PAGE_SIZE=4096
CONFIG_SYS_NAND_PAGE_SIZE=8192
CONFIG_SYS_NAND_OOBSIZE=640
CONFIG_SYS_NAND_BLOCK_SIZE=0x100000
#CONFIG_SYS_EXTRA_OPTIONS="SYS_NAND_PAGE_SIZE=8192,SYS_NAND_OOBSIZE=640,SYS_NAND_BLOCK_SIZE=0x100000"
#
#cmd_sunxi_spl_image_builder = $(objtree)/tools/sunxi-spl-image-builder \
#				-c $(CONFIG_NAND_SUNXI_SPL_ECC_STRENGTH)/$(CONFIG_NAND_SUNXI_SPL_ECC_SIZE) \
#				-p $(CONFIG_SYS_NAND_PAGE_SIZE) \
#				-o $(CONFIG_SYS_NAND_OOBSIZE) \
#				-u $(CONFIG_NAND_SUNXI_SPL_USABLE_PAGE_SIZE) \
#				-e $(CONFIG_SYS_NAND_BLOCK_SIZE) \
#
CONFIG_CMD_EXT4=y
CONFIG_CMD_NAND=y
#CONFIG_CMD_MTDPARTS=y
#CONFIG_CMD_UBI=y
#CONFIG_CMD_UBIFS=y
```
